#include <U8g2lib.h>
#include <SoftwareSerial.h>
#include <TinyGPS++.h>
#include <EEPROMex.h>
#include <EEPROMVar.h>

U8G2_SSD1306_128X64_NONAME_1_HW_I2C u8g2(U8G2_R0, /* reset=*/ U8X8_PIN_NONE);

static const unsigned char GALANT_LOGO[] PROGMEM = {
	0x00, 0x00, 0x00, 0x00, 0x00, 0x00, 0x00, 0x00, 0x00, 0x00, 0x00, 0x00, 0x00, 0x00, 0x00, 0x00, 
	0x00, 0x00, 0x00, 0x00, 0x00, 0x00, 0x00, 0x00, 0x00, 0x00, 0x00, 0x00, 0x00, 0x00, 0x00, 0x00, 
	0x00, 0x00, 0x00, 0x00, 0x00, 0x00, 0x00, 0x00, 0x00, 0x00, 0x00, 0x00, 0x00, 0x00, 0x00, 0x00, 
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	0x00, 0x00, 0x00, 0x00, 0x00, 0x00, 0x00, 0x00, 0x00, 0x00, 0x00, 0x00, 0x00, 0x00, 0x00, 0x00
};

#define RX_PIN 4
#define TX_PIN 3

TinyGPSPlus gps;
SoftwareSerial ssgps(RX_PIN, TX_PIN);

double total_distance = 0.0;
double prev_latitude = 0.0;
double prev_longitude = 0.0;

#define MIN_METER_THRESHOLD 1

bool disp_icon_save = false;
bool disp_icon_nosignal = false;

int save_counter = 0;

void setup() {

    // Serial.begin(9600); // Baud = 9600
    ssgps.begin(9600); // GPSBaud = 9600
    u8g2.begin();

    u8g2.firstPage();
    do {
        u8g2.drawXBMP(0, 0, 128, 64, GALANT_LOGO);
    } while (u8g2.nextPage());
    delay(10000);

    loadData();

}

void loop() {

    if (save_counter++ == 50) { // update data every ~60 secs
        disp_icon_save = true;
        saveData();
        save_counter = 0;
    }

    readGPS();

    u8g2.firstPage();
    do {
        displayDistance();
    } while (u8g2.nextPage());

    disp_icon_save = false;

}

void readGPS() {
    
    bool new_data = false;
    unsigned long start = millis();

    while (millis() - start < 1000) {
        while (!new_data && ssgps.available()) {
            if (gps.encode(ssgps.read())) {
                new_data = true;
            }
        }
    }

    if (new_data) {
        disp_icon_nosignal = false;
        processData();
    }
    else {
        disp_icon_nosignal = true;
    }

}

void processData() {

    if (gps.location.isValid()) {

        double cur_latitude = gps.location.lat();
        double cur_longitude = gps.location.lng();
        
        if (prev_latitude != 0.0 && prev_longitude != 0.0) {

            double distance = gps.distanceBetween(prev_latitude, prev_longitude, cur_latitude, cur_longitude);

            if (distance >= MIN_METER_THRESHOLD) { // threshold filter
                distance /= 1000; // convert to kilometer
                total_distance += distance;
            }

        }

        prev_latitude = cur_latitude;
        prev_longitude = cur_longitude;

    }

}

void displayDistance() {

    int x = 11;
    int y = 19;
    int char_offset = 28; // char height 24 + space 4

    u8g2.setFont(u8g2_font_logisoso24_tn);
    u8g2.setFontMode(1);
    u8g2.setFontPosTop();
    u8g2.setDrawColor(1);

    unsigned long total_distance_long = (unsigned long) total_distance;
    double position_offset = (total_distance - total_distance_long) * char_offset;

    u8g2.drawBox(x + 89, y - 2, 18, 30);
    u8g2.setDrawColor(0);

    int rightmost = total_distance_long % 10;
    u8g2.setCursor(x + 90, y - position_offset);
    u8g2.print(rightmost);

    int rightmost_plus = (rightmost + 1) % 10;
    u8g2.setCursor(x + 90, (y + char_offset) - position_offset);
    u8g2.print(rightmost_plus);

    u8g2.setDrawColor(1);

    bool move_next_digit = (rightmost == 9);

    for (int i = 1; i <= 5; i++) {

        unsigned long power = 1;
        for (int j = 0; j < i; j++) { // using pow(10, i) gives an unexpected result
            power *= 10;
        }

        int cur_digit = total_distance_long / power % 10;

        if (move_next_digit) {

            u8g2.setCursor(x + 90 - (18 * i), y - position_offset);
            u8g2.print(cur_digit);

            int cur_digit_plus = (cur_digit + 1) % 10;
            u8g2.setCursor(x + 90 - (18 * i), (y + char_offset) - position_offset);
            u8g2.print(cur_digit_plus);

        }
        else {
            u8g2.setCursor(x + 90 - (18 * i), y);
            u8g2.print(cur_digit);
        }

        move_next_digit = (move_next_digit && cur_digit == 9 && rightmost == 9);

    }

    u8g2.setDrawColor(0);
    u8g2.drawBox(x - 2, 0, 110, 16);
    u8g2.drawBox(x - 2, y + 29, 110, 16);

    u8g2.setDrawColor(1);
    u8g2.drawRFrame(x - 2, y - 3, 110, 32, 3);

    if (disp_icon_save) {
        u8g2.setFont(u8g2_font_waffle_t_all); // 8x8
        u8g2.drawGlyph(116, 9, 0xe147);
    }

    if (disp_icon_nosignal) {
        u8g2.setFont(u8g2_font_waffle_t_all); // 8x8
        u8g2.drawGlyph(0, 61, 0xe1ba);
        u8g2.drawGlyph(8, 61, 0xe0b3);
    }

}

void loadData() {
    double distance = EEPROM.readDouble(0);
    if (!isnan(distance)) { 
        total_distance = distance;
    }
}

void saveData() {
    EEPROM.updateDouble(0, total_distance);
    // EEPROM.updateDouble(0, 238103.00); // latest distance from the car
}
