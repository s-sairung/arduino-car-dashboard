#include <SPI.h>
#include <Wire.h>
#include <Adafruit_GFX.h>
#include <Adafruit_SSD1306.h>
#include <SoftwareSerial.h>
#include <TinyGPS++.h>

#define SCREEN_WIDTH    128
#define SCREEN_HEIGHT   64
#define OLED_RESET      -1
#define OLED_ADDRESS    0x3C

Adafruit_SSD1306 OLED(SCREEN_WIDTH, SCREEN_HEIGHT, &Wire, OLED_RESET);

static const unsigned int RXPin = 4;
static const unsigned int TXPin = 3;

TinyGPSPlus GPS;
SoftwareSerial SSGPS(RXPin, TXPin);

static const unsigned char galantLogo[] PROGMEM = {
  0x00, 0x00, 0x00, 0x00, 0x00, 0x00, 0x00, 0x00, 0x00, 0x00, 0x00, 0x00, 0x00, 0x00, 0x00, 0x00, 
  0x00, 0x00, 0x00, 0x00, 0x00, 0x00, 0x00, 0x00, 0x00, 0x00, 0x00, 0x00, 0x00, 0x00, 0x00, 0x00, 
  0x00, 0x00, 0x00, 0x00, 0x00, 0x00, 0x00, 0x00, 0x00, 0x00, 0x00, 0x00, 0x00, 0x00, 0x00, 0x00, 
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  0x00, 0x00, 0x00, 0x00, 0x00, 0x00, 0x00, 0x00, 0x00, 0x00, 0x00, 0x00, 0x00, 0x00, 0x00, 0x00
};

enum DisplayMode {
    SPEED,
    DISTANCE
};

DisplayMode displayMode = DISTANCE;

unsigned int currentSpeed;
double totalDistance = 98980;

double previousLatitude = 0.0;
double previousLongitude = 0.0;

void setup() {

    Serial.begin(9600); // Baud = 9600
    SSGPS.begin(9600); // GPSBaud = 9600

    if (!OLED.begin(SSD1306_SWITCHCAPVCC, OLED_ADDRESS)) {
        Serial.println("SSD1306 (OLED) allocation failed.");
        for (;;);
    }
    OLED.clearDisplay();
    OLED.drawBitmap(0, 0, galantLogo, 128, 64, WHITE);
    OLED.display();
    delay(10000);

}

void loop() {
    readGPS();
}

void readGPS() {
    bool newData = false;
    for (unsigned long start = millis(); millis() - start < 1000;) {
        while (SSGPS.available()) {
            if (GPS.encode(SSGPS.read())) {
                newData = true;
                break;
            }
        }
    }
    if (newData) {
        newData = false;
        processData();
    }
    else {} // no data -> do nothing
}

void processData() {
    if (GPS.location.isValid()) {
        currentSpeed = GPS.speed.kmph();
        double currentLatitude = GPS.location.lat();
        double currentLongitude = GPS.location.lng();
        if (previousLatitude != 0.0 && previousLongitude != 0.0) {
            totalDistance += GPS.distanceBetween(previousLatitude, previousLongitude, currentLatitude, currentLongitude);
        }
        previousLatitude = currentLatitude;
        previousLongitude = currentLongitude;
    }
    switch (displayMode) {
        case SPEED:
            displaySpeed();
            break;
        case DISTANCE:
            displayDistance();
            break;
    }
}

void displaySpeed() {

    // TODO: Confirm that everything is right aligned
    OLED.clearDisplay();
    OLED.setTextColor(WHITE, BLACK);
    OLED.setTextSize(7); // Character dimension: 5x7 + right padding 1 & bottom padding 1 = 6x8

    if (currentSpeed > 99)
        OLED.setCursor(2, 8);
    else if (currentSpeed > 9)
        OLED.setCursor(44, 8);
    else
        OLED.setCursor(86, 8);

    OLED.print(currentSpeed);
    OLED.display();

}

void displayDistance() {

    int x = 11;
    int y = 21;
    unsigned long totalDistanceLong = (unsigned long) totalDistance;

    OLED.setTextSize(3);
    OLED.setCursor(x, y);
    // char distance[10];
    // sprintf(distance, "%05lu", totalDistanceLong / 10);
    // OLED.print(distance);

    double offset = (totalDistance - totalDistanceLong) * 24;

    OLED.setTextColor(BLACK);
    OLED.fillRect(x + 89, y, 17, 21, WHITE);

    int rightMost = totalDistanceLong % 10;
    OLED.setCursor(x + 90, y - offset);
    OLED.print(rightMost);

    int rightMostPlus = (rightMost + 1) % 10;
    OLED.setCursor(x + 90, (y + 24) - offset);
    OLED.print(rightMostPlus);

    OLED.setTextColor(WHITE);
    bool moveNextDigit = false;
    if (rightMost == 9) {
        moveNextDigit = true;
    }
    for (int i = 1; i <= 5; i++) {
        unsigned long power = 1;
        for (int j = 0; j < i; j++) { // using pow(10, i) gives an unexpected result
            power *= 10;
        }

        int curDigit = totalDistanceLong / power % 10;
        
        if (moveNextDigit) {
            OLED.setCursor(x + 90 - (18 * i), y - offset);
            OLED.print(curDigit);
            int curDigitPlus = (curDigit + 1) % 10;
            OLED.setCursor(x + 90 - (18 * i), (y + 24) - offset);
            OLED.print(curDigitPlus);
        }
        else {
            OLED.setCursor(x + 90 - (18 * i), y);
            OLED.print(curDigit);
        }

        if (curDigit == 9 && rightMost == 9 && moveNextDigit) {
            moveNextDigit = true;
        }
        else {
            moveNextDigit = false;
        }
    }

    // OLED.drawLine(x + 16, y - 3, x + 16, y + 23, WHITE);
    // OLED.drawLine(x + 34, y - 3, x + 34, y + 23, WHITE);
    // OLED.drawLine(x + 52, y - 3, x + 52, y + 23, WHITE);
    // OLED.drawLine(x + 70, y - 3, x + 70, y + 23, WHITE);
    // OLED.drawLine(x + 88, y - 3, x + 88, y + 23, WHITE);
    OLED.fillRect(8, 0, 111, 18, BLACK);
    OLED.fillRect(8, 45, 111, 19, BLACK);
    OLED.drawRoundRect(x - 3, y - 3, 111, 27, 3, WHITE);

    OLED.display();

}